//	font created using dot factory
//	http://www.pavius.net/2009/07/the-dot-factory-an-lcd-font-and-image-generator/
const char fontBitmaps[] = 
{

	// @270 '0' (30 pixels wide)
	0x00, 0xFF, 0xFF, 0xFF, 0xFF, 0xFF, 0xFF, 0x80, 0x00, //         #################################################          
	0x07, 0xFF, 0xFF, 0xFF, 0xFF, 0xFF, 0xFF, 0xF0, 0x00, //      #######################################################       
	0x0F, 0xFF, 0xFF, 0xFF, 0xFF, 0xFF, 0xFF, 0xFC, 0x00, //     ##########################################################     
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	0x00, 0x00, 0x00, 0x00, 0x00, 0x00, 0x00, 0x00, 0x00, //                                                                    

	// @540 '1' (30 pixels wide)
	0x00, 0x00, 0x00, 0x00, 0x00, 0x00, 0x00, 0x00, 0x00, //                                                                    
	0x00, 0x00, 0x00, 0x00, 0x00, 0x00, 0x00, 0x00, 0x00, //                                                                    
	0x00, 0x00, 0x00, 0x00, 0x00, 0x00, 0x00, 0x00, 0x00, //                                                                    
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	0x00, 0x00, 0x00, 0x00, 0x00, 0x00, 0x00, 0x00, 0x00, //                                                                    

	// @810 '2' (30 pixels wide)
	0x00, 0xF0, 0x00, 0x00, 0x00, 0x00, 0xFF, 0xFF, 0xE0, //         ####                                    ###################
	0x07, 0xF0, 0x00, 0x00, 0x00, 0x03, 0xFF, 0xFF, 0xE0, //      #######                                  #####################
	0x0F, 0xF0, 0x00, 0x00, 0x00, 0x07, 0xFF, 0xFF, 0xE0, //     ########                                 ######################
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	0x00, 0x00, 0x00, 0x00, 0x00, 0x00, 0x00, 0x00, 0x00, //                                                                    

	// @1080 '3' (30 pixels wide)
	0x00, 0xF0, 0x00, 0x00, 0x00, 0x00, 0x0F, 0x80, 0x00, //         ####                                        #####          
	0x07, 0xF0, 0x00, 0x00, 0x00, 0x00, 0x0F, 0xF0, 0x00, //      #######                                        ########       
	0x0F, 0xF0, 0x00, 0x00, 0x00, 0x00, 0x0F, 0xFC, 0x00, //     ########                                        ##########     
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	0x00, 0x00, 0x00, 0x00, 0x00, 0x00, 0x00, 0x00, 0x00, //                                                                    

	// @1350 '4' (30 pixels wide)
	0x00, 0x00, 0x00, 0x00, 0x00, 0x00, 0x20, 0x00, 0x00, //                                                   #                
	0x00, 0x00, 0x00, 0x00, 0x00, 0x01, 0xE0, 0x00, 0x00, //                                                ####                
	0x00, 0x00, 0x00, 0x00, 0x00, 0x07, 0xE0, 0x00, 0x00, //                                              ######                
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	0x00, 0x00, 0x00, 0x00, 0x00, 0x00, 0xE0, 0x00, 0x00, //                                                 ###                

	// @1620 '5' (30 pixels wide)
	0xFF, 0xFF, 0xFF, 0xFF, 0x80, 0x00, 0x0F, 0x80, 0x00, // #################################                   #####          
	0xFF, 0xFF, 0xFF, 0xFF, 0x80, 0x00, 0x0F, 0xF0, 0x00, // #################################                   ########       
	0xFF, 0xFF, 0xFF, 0xFF, 0x80, 0x00, 0x0F, 0xFC, 0x00, // #################################                   ##########     
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	0x00, 0x00, 0x00, 0x00, 0x00, 0x00, 0x00, 0x00, 0x00, //                                                                    

	// @1890 '6' (30 pixels wide)
	0x01, 0xFF, 0xFF, 0xFF, 0xFF, 0xFF, 0xFF, 0x80, 0x00, //        ##################################################          
	0x07, 0xFF, 0xFF, 0xFF, 0xFF, 0xFF, 0xFF, 0xF0, 0x00, //      #######################################################       
	0x0F, 0xFF, 0xFF, 0xFF, 0xFF, 0xFF, 0xFF, 0xFC, 0x00, //     ##########################################################     
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	0x00, 0x00, 0x00, 0x00, 0x00, 0x00, 0x00, 0x00, 0x00, //                                                                    

	// @2160 '7' (30 pixels wide)
	0x00, 0x00, 0x00, 0x00, 0x00, 0x00, 0x00, 0x00, 0x00, //                                                                    
	0xE0, 0x00, 0x00, 0x00, 0x00, 0x00, 0x00, 0x00, 0x00, // ###                                                                
	0xE0, 0x00, 0x00, 0x00, 0x00, 0x00, 0x00, 0x00, 0x00, // ###                                                                
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	0x00, 0x00, 0x00, 0x00, 0x00, 0x00, 0x00, 0x00, 0x00, //                                                                    

	// @2430 '8' (30 pixels wide)
	0x00, 0xFF, 0xFE, 0x00, 0x07, 0xFF, 0xFF, 0x80, 0x00, //         ###############              ####################          
	0x07, 0xFF, 0xFF, 0xC0, 0x1F, 0xFF, 0xFF, 0xF0, 0x00, //      #####################         #########################       
	0x0F, 0xFF, 0xFF, 0xF0, 0x3F, 0xFF, 0xFF, 0xFC, 0x00, //     ########################      ############################     
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	0x00, 0x00, 0x00, 0x00, 0x00, 0x00, 0x00, 0x00, 0x00, //                                                                    

	// @2700 '9' (30 pixels wide)
	0x00, 0x3F, 0xFF, 0xE0, 0x00, 0x00, 0x07, 0x80, 0x00, //           #################                          ####          
	0x01, 0xFF, 0xFF, 0xFC, 0x00, 0x00, 0x07, 0xF0, 0x00, //        #######################                       #######       
	0x07, 0xFF, 0xFF, 0xFF, 0x00, 0x00, 0x07, 0xFC, 0x00, //      ###########################                     #########     
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	0x00, 0x00, 0x00, 0x00, 0x00, 0x00, 0x00, 0x00, 0x00, //                                                                    

	// @2970 'A' (30 pixels wide)
	0x00, 0x00, 0x00, 0x00, 0x00, 0x00, 0x00, 0x00, 0x00, //                                                                    
	0x00, 0x00, 0x00, 0x00, 0x00, 0x00, 0x00, 0x00, 0xE0, //                                                                 ###
	0x00, 0x00, 0x00, 0x00, 0x00, 0x00, 0x00, 0x1F, 0xE0, //                                                            ########
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	0x00, 0x00, 0x00, 0x00, 0x00, 0x00, 0x00, 0x00, 0x00, //                                                                    

	// @3240 'B' (30 pixels wide)
	0x00, 0x00, 0x00, 0x00, 0x00, 0x00, 0x00, 0x00, 0x00, //                                                                    
	0xFF, 0xFF, 0xFF, 0xFF, 0xFF, 0xFF, 0xFF, 0xFF, 0xE0, // ###################################################################
	0xFF, 0xFF, 0xFF, 0xFF, 0xFF, 0xFF, 0xFF, 0xFF, 0xE0, // ###################################################################
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	0x00, 0x00, 0x00, 0x00, 0x00, 0x00, 0x00, 0x00, 0x00, //                                                                    

	// @3510 'C' (30 pixels wide)
	0x00, 0xFF, 0xFF, 0xFF, 0xFF, 0xFF, 0xFF, 0x80, 0x00, //         #################################################          
	0x07, 0xFF, 0xFF, 0xFF, 0xFF, 0xFF, 0xFF, 0xF0, 0x00, //      #######################################################       
	0x0F, 0xFF, 0xFF, 0xFF, 0xFF, 0xFF, 0xFF, 0xFC, 0x00, //     ##########################################################     
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	0x00, 0x00, 0x00, 0x00, 0x00, 0x00, 0x00, 0x00, 0x00, //                                                                    

	// @3780 'D' (30 pixels wide)
	0x00, 0x00, 0x00, 0x00, 0x00, 0x00, 0x00, 0x00, 0x00, //                                                                    
	0xFF, 0xFF, 0xFF, 0xFF, 0xFF, 0xFF, 0xFF, 0xFF, 0xE0, // ###################################################################
	0xFF, 0xFF, 0xFF, 0xFF, 0xFF, 0xFF, 0xFF, 0xFF, 0xE0, // ###################################################################
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	0x00, 0x00, 0x00, 0x00, 0x00, 0x00, 0x00, 0x00, 0x00, //                                                                    

	// @4050 'E' (30 pixels wide)
	0x00, 0x00, 0x00, 0x00, 0x00, 0x00, 0x00, 0x00, 0x00, //                                                                    
	0xFF, 0xFF, 0xFF, 0xFF, 0xFF, 0xFF, 0xFF, 0xFF, 0xE0, // ###################################################################
	0xFF, 0xFF, 0xFF, 0xFF, 0xFF, 0xFF, 0xFF, 0xFF, 0xE0, // ###################################################################
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	0x00, 0x00, 0x00, 0x00, 0x00, 0x00, 0x00, 0x00, 0x00, //                                                                    

	
/*	
	// @4320 'F' (30 pixels wide)
	0x00, 0x00, 0x00, 0x00, 0x00, 0x00, 0x00, 0x00, 0x00, //                                                                    
	0x00, 0x00, 0x00, 0x00, 0x00, 0x00, 0x00, 0x00, 0x00, //                                                                    
	0x7F, 0xFF, 0xFF, 0xFF, 0xFF, 0xFF, 0xFF, 0xFF, 0xE0, //  ##################################################################
	0x7F, 0xFF, 0xFF, 0xFF, 0xFF, 0xFF, 0xFF, 0xFF, 0xE0, //  ##################################################################
	0x7F, 0xFF, 0xFF, 0xFF, 0xFF, 0xFF, 0xFF, 0xFF, 0xE0, //  ##################################################################
	0x70, 0x00, 0x00, 0x01, 0xC0, 0x00, 0x00, 0x00, 0x00, //  ###                           ###                                 
	0x70, 0x00, 0x00, 0x01, 0xC0, 0x00, 0x00, 0x00, 0x00, //  ###                           ###                                 
	0x70, 0x00, 0x00, 0x01, 0xC0, 0x00, 0x00, 0x00, 0x00, //  ###                           ###                                 
	0x70, 0x00, 0x00, 0x01, 0xC0, 0x00, 0x00, 0x00, 0x00, //  ###                           ###                                 
	0x70, 0x00, 0x00, 0x01, 0xC0, 0x00, 0x00, 0x00, 0x00, //  ###                           ###                                 
	0x70, 0x00, 0x00, 0x01, 0xC0, 0x00, 0x00, 0x00, 0x00, //  ###                           ###                                 
	0x70, 0x00, 0x00, 0x01, 0xC0, 0x00, 0x00, 0x00, 0x00, //  ###                           ###                                 
	0x70, 0x00, 0x00, 0x01, 0xC0, 0x00, 0x00, 0x00, 0x00, //  ###                           ###                                 
	0x70, 0x00, 0x00, 0x01, 0xC0, 0x00, 0x00, 0x00, 0x00, //  ###                           ###                                 
	0x70, 0x00, 0x00, 0x01, 0xC0, 0x00, 0x00, 0x00, 0x00, //  ###                           ###                                 
	0x70, 0x00, 0x00, 0x01, 0xC0, 0x00, 0x00, 0x00, 0x00, //  ###                           ###                                 
	0x70, 0x00, 0x00, 0x01, 0xC0, 0x00, 0x00, 0x00, 0x00, //  ###                           ###                                 
	0x70, 0x00, 0x00, 0x01, 0xC0, 0x00, 0x00, 0x00, 0x00, //  ###                           ###                                 
	0x70, 0x00, 0x00, 0x01, 0xC0, 0x00, 0x00, 0x00, 0x00, //  ###                           ###                                 
	0x70, 0x00, 0x00, 0x01, 0xC0, 0x00, 0x00, 0x00, 0x00, //  ###                           ###                                 
	0x70, 0x00, 0x00, 0x01, 0xC0, 0x00, 0x00, 0x00, 0x00, //  ###                           ###                                 
	0x70, 0x00, 0x00, 0x01, 0xC0, 0x00, 0x00, 0x00, 0x00, //  ###                           ###                                 
	0x70, 0x00, 0x00, 0x01, 0xC0, 0x00, 0x00, 0x00, 0x00, //  ###                           ###                                 
	0x70, 0x00, 0x00, 0x01, 0xC0, 0x00, 0x00, 0x00, 0x00, //  ###                           ###                                 
	0x70, 0x00, 0x00, 0x00, 0x00, 0x00, 0x00, 0x00, 0x00, //  ###                                                               
	0x70, 0x00, 0x00, 0x00, 0x00, 0x00, 0x00, 0x00, 0x00, //  ###                                                               
	0x70, 0x00, 0x00, 0x00, 0x00, 0x00, 0x00, 0x00, 0x00, //  ###                                                               
	0x70, 0x00, 0x00, 0x00, 0x00, 0x00, 0x00, 0x00, 0x00, //  ###                                                               
	0x70, 0x00, 0x00, 0x00, 0x00, 0x00, 0x00, 0x00, 0x00, //  ###                                                               
	0x00, 0x00, 0x00, 0x00, 0x00, 0x00, 0x00, 0x00, 0x00, //                                                                    
 
 */
 

 
 
	0x00, 0x00, 0x00, 0x00, 0x00, 0x00, 0x00, 0x00, 0x00, //                                                                    
	0x00, 0x00, 0x00, 0x00, 0x00, 0x00, 0x00, 0x00, 0x00, //                                                                    
	0x00, 0x00, 0x00, 0x00, 0x00, 0x00, 0x00, 0x00, 0x00, //                                                                    
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	0x00, 0x00, 0x00, 0x00, 0x00, 0x00, 0x00, 0x00, 0x00, //                                                                    



 
	// @0 '+' (30 pixels wide)
	0x00, 0x00, 0x00, 0x00, 0x00, 0x00, 0x00, 0x00, 0x00, //   modded!!                                                                 
	0x00, 0x00, 0x00, 0x00, 0x00, 0x00, 0x00, 0x00, 0x00, //                                                                    
	0x00, 0x00, 0x00, 0x00, 0x00, 0x00, 0x00, 0x00, 0x00, //                                                                    
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	0x00, 0x00, 0x00, 0x00, 0x00, 0x00, 0x00, 0x00, 0x00, //                                                                    

	// @270 '-' (30 pixels wide)
	0x00, 0x00, 0x00, 0x00, 0x00, 0x00, 0x00, 0x00, 0x00, //                                                                    
	0x00, 0x00, 0x00, 0x00, 0x00, 0x00, 0x00, 0x00, 0x00, //                                                                    
	0x00, 0x00, 0x00, 0x00, 0x00, 0x00, 0x00, 0x00, 0x00, //                                                                    
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	0x00, 0x00, 0x00, 0x00, 0x00, 0x00, 0x00, 0x00, 0x00, //                                                                                     

};






























// Character bitmaps for OpenSymbol 18pt
//const uint_8 openSymbol_18ptBitmaps[] = 
//const uint_8 minifont[] = 
//const unsigned char minifont[] = 
//const uint_8 openSymbol_16ptBitmaps[] =
 const unsigned char minifont[] = 

{
	// @0 '!' (20 pixels wide)
	0x00, 0x00, 0x00, //                      
	0x00, 0x00, 0x00, //                      
	0x00, 0x00, 0x00, //                      
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	0x00, 0x00, 0x00, //                      

	// @60 '"' (20 pixels wide)
	0x00, 0x00, 0x00, //                      
	0x00, 0x00, 0x00, //                      
	0x00, 0x00, 0x00, //                      
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	0x00, 0x00, 0x00, //                      

	// @120 '#' (20 pixels wide)
	0x00, 0x00, 0x00, //                      
	0x00, 0x00, 0x00, //                      
	0x00, 0x00, 0x00, //                      
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	0x00, 0x00, 0x00, //                      

	// @180 '$' (20 pixels wide)
	0x00, 0x00, 0x00, //                      
	0x00, 0x00, 0x00, //                      
	0x00, 0x00, 0x00, //                      
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	0x00, 0x00, 0x00, //                      

	// @240 '%' (20 pixels wide)
	0x00, 0x00, 0x00, //                      
	0x0F, 0x00, 0x00, //     ####             
	0x3F, 0xC0, 0x00, //   ########           
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	0x00, 0x00, 0x00, //                      

	// @300 '&' (20 pixels wide)
	0x00, 0x00, 0x00, //                      
	0x00, 0x0F, 0x00, //             ####     
	0x00, 0x3F, 0x80, //           #######    
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	0x00, 0x00, 0x00, //                      

	// @360 ''' (20 pixels wide)
	0x00, 0x00, 0x00, //                      
	0x00, 0x00, 0x00, //                      
	0x00, 0x00, 0x00, //                      
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	0x00, 0x00, 0x00, //                      

	// @420 '(' (20 pixels wide)
	0x00, 0x00, 0x00, //                      
	0x00, 0x00, 0x00, //                      
	0x00, 0x00, 0x00, //                      
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	0x00, 0x00, 0x00, //                      

	// @480 ')' (20 pixels wide)
	0x00, 0x00, 0x00, //                      
	0x00, 0x00, 0x00, //                      
	0x00, 0x00, 0x00, //                      
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	0x00, 0x00, 0x00, //                      

	// @540 '*' (20 pixels wide)
	0x00, 0x00, 0x00, //                      
	0x00, 0x00, 0x00, //                      
	0x00, 0x00, 0x00, //                      
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	0x00, 0x00, 0x00, //                      

	// @600 '+' (20 pixels wide)
	0x00, 0x00, 0x00, //                      
	0x00, 0x00, 0x00, //                      
	0x00, 0x00, 0x00, //                      
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	0x00, 0x00, 0x00, //                      

	// @660 ',' (20 pixels wide)
	0x00, 0x00, 0x00, //                      
	0x00, 0x00, 0x00, //                      
	0x00, 0x00, 0x00, //                      
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	0x00, 0x00, 0x00, //                      

	// @720 '-' (20 pixels wide)
	0x00, 0x00, 0x00, //                      
	0x00, 0x00, 0x00, //                      
	0x00, 0x00, 0x00, //                      
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	0x00, 0x00, 0x00, //                      

	// @780 '.' (20 pixels wide)
	0x00, 0x00, 0x00, //                      
	0x00, 0x00, 0x00, //                      
	0x00, 0x00, 0x00, //                      
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	0x00, 0x00, 0x00, //                      

	// @840 '/' (20 pixels wide)
	0x00, 0x00, 0x00, //                      
	0x00, 0x00, 0x00, //                      
	0x00, 0x00, 0x00, //                      
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	0x00, 0x00, 0x00, //                      

	// @900 '0' (20 pixels wide)
	0x00, 0x00, 0x00, //                      
	0x00, 0x00, 0x00, //                      
	0x00, 0x00, 0x00, //                      
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	0x00, 0x00, 0x00, //                      

	// @960 '1' (20 pixels wide)
	0x00, 0x00, 0x00, //                      
	0x00, 0x00, 0x00, //                      
	0x00, 0x00, 0x00, //                      
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	0x00, 0x00, 0x00, //                      

	// @1020 '2' (20 pixels wide)
	0x00, 0x00, 0x00, //                      
	0x00, 0x00, 0x00, //                      
	0x00, 0x00, 0x00, //                      
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	0x00, 0x00, 0x00, //                      

	// @1080 '3' (20 pixels wide)
	0x00, 0x00, 0x00, //                      
	0x00, 0x00, 0x00, //                      
	0x00, 0x00, 0x00, //                      
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	0x00, 0x00, 0x00, //                      

	// @1140 '4' (20 pixels wide)
	0x00, 0x00, 0x00, //                      
	0x00, 0x00, 0x00, //                      
	0x00, 0x00, 0x00, //                      
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	0x00, 0x00, 0x00, //                      

	// @1200 '5' (20 pixels wide)
	0x00, 0x00, 0x00, //                      
	0x00, 0x00, 0x00, //                      
	0x00, 0x00, 0x00, //                      
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	0x00, 0x00, 0x00, //                      

	// @1260 '6' (20 pixels wide)
	0x00, 0x00, 0x00, //                      
	0x00, 0x00, 0x00, //                      
	0x00, 0x00, 0x00, //                      
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	0x00, 0x00, 0x00, //                      

	// @1320 '7' (20 pixels wide)
	0x00, 0x00, 0x00, //                      
	0x00, 0x00, 0x00, //                      
	0x00, 0x00, 0x00, //                      
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	0x00, 0x00, 0x00, //                      

	// @1380 '8' (20 pixels wide)
	0x00, 0x00, 0x00, //                      
	0x00, 0x00, 0x00, //                      
	0x00, 0x00, 0x00, //                      
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	0x00, 0x00, 0x00, //                      

	// @1440 '9' (20 pixels wide)
	0x00, 0x00, 0x00, //                      
	0x00, 0x00, 0x00, //                      
	0x00, 0x00, 0x00, //                      
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	0x00, 0x00, 0x00, //                      

	// @1500 ':' (20 pixels wide)
	0x00, 0x00, 0x00, //                      
	0x00, 0x00, 0x00, //                      
	0x00, 0x00, 0x00, //                      
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	0x00, 0x00, 0x00, //                      

	// @1560 ';' (20 pixels wide)
	0x00, 0x00, 0x00, //                      
	0x00, 0x00, 0x00, //                      
	0x00, 0x00, 0x00, //                      
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	0x00, 0x00, 0x00, //                      

	// @1620 '<' (20 pixels wide)
	0x00, 0x00, 0x00, //                      
	0x00, 0x00, 0x00, //                      
	0x00, 0x00, 0x00, //                      
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	0x00, 0x00, 0x00, //                      

	// @1680 '=' (20 pixels wide)
	0x00, 0x00, 0x00, //                      
	0x00, 0x00, 0x00, //                      
	0x00, 0x00, 0x00, //                      
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	0x00, 0x00, 0x00, //                      

	// @1740 '>' (20 pixels wide)
	0x00, 0x00, 0x00, //                      
	0x00, 0x00, 0x00, //                      
	0x00, 0x00, 0x00, //                      
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	0x00, 0x00, 0x00, //                      
/*
	// @1800 '?' (20 pixels wide)
	0x00, 0x00, 0x00, //                      
	0x00, 0x00, 0x00, //                      
	0x00, 0x00, 0x00, //                      
	0x00, 0x00, 0x00, //                      
	0x00, 0x00, 0x00, //                      
	0x0C, 0x00, 0x00, //     ##               
	0x1C, 0x00, 0x00, //    ###               
	0x3C, 0x00, 0x00, //   ####               
	0x38, 0x00, 0x00, //   ###                
	0x30, 0x39, 0x80, //   ##      ###  ##    
	0x30, 0x79, 0x80, //   ##     ####  ##    
	0x38, 0xF9, 0x80, //   ###   #####  ##    
	0x3F, 0xE0, 0x00, //   #########          
	0x1F, 0x80, 0x00, //    ######            
	0x0F, 0x00, 0x00, //     ####             
	0x00, 0x00, 0x00, //                      
	0x00, 0x00, 0x00, //                      
	0x00, 0x00, 0x00, //                      
	0x00, 0x00, 0x00, //                      
	0x00, 0x00, 0x00, //                      
*/
	0x00, 0x00, 0x00, //               //hack to show blank character when over range       
	0x00, 0x00, 0x00, //                      
	0x00, 0x00, 0x00, //                      
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	0x00, 0x00, 0x00, //           	
	
	
	
	// @1860 '@' (20 pixels wide)
	0x00, 0x7F, 0x00, //          #######     
	0x01, 0xFF, 0xC0, //        ###########   
	0x07, 0xFF, 0xE0, //      ##############  
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	0x01, 0xF8, 0x00, //        ######        

	// @1920 'A' (20 pixels wide)
	0x00, 0x00, 0x00, //                      
	0x00, 0x00, 0x00, //                      
	0x00, 0x00, 0x00, //                      
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	0x00, 0x00, 0x00, //                      

	// @1980 'B' (20 pixels wide)
	0x00, 0x00, 0x00, //                      
	0x00, 0x00, 0x00, //                      
	0x00, 0x00, 0x00, //                      
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	0x00, 0x00, 0x00, //                      

	// @2040 'C' (20 pixels wide)
	0x00, 0x00, 0x00, //                      
	0x00, 0x00, 0x00, //                      
	0x00, 0x00, 0x00, //                      
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	0x00, 0x00, 0x00, //                      

	// @2100 'D' (20 pixels wide)
	0x00, 0x00, 0x00, //                      
	0x00, 0x00, 0x00, //                      
	0x00, 0x00, 0x00, //                      
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	0x00, 0x00, 0x00, //                      

	// @2160 'E' (20 pixels wide)
	0x00, 0x00, 0x00, //                      
	0x00, 0x00, 0x00, //                      
	0x00, 0x00, 0x00, //                      
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	0x00, 0x00, 0x00, //                      

	// @2220 'F' (20 pixels wide)
	0x00, 0x00, 0x00, //                      
	0x00, 0x00, 0x00, //                      
	0x00, 0x00, 0x00, //                      
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	0x00, 0x00, 0x00, //                      

	// @2280 'G' (20 pixels wide)
	0x00, 0x00, 0x00, //                      
	0x00, 0x00, 0x00, //                      
	0x03, 0xF8, 0x00, //       #######        
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	0x00, 0x00, 0x00, //                      

	// @2340 'H' (20 pixels wide)
	0x00, 0x00, 0x00, //                      
	0x00, 0x00, 0x00, //                      
	0x00, 0x00, 0x00, //                      
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	0x00, 0x00, 0x00, //                      

	// @2400 'I' (20 pixels wide)
	0x00, 0x00, 0x00, //                      
	0x00, 0x00, 0x00, //                      
	0x00, 0x00, 0x00, //                      
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	0x00, 0x00, 0x00, //                      

	// @2460 'J' (20 pixels wide)
	0x00, 0x00, 0x00, //                      
	0x00, 0x00, 0x00, //                      
	0x00, 0x00, 0x00, //                      
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	0x00, 0x00, 0x00, //                      

	// @2520 'K' (20 pixels wide)
	0x00, 0x00, 0x00, //                      
	0x00, 0x00, 0x00, //                      
	0x00, 0x00, 0x00, //                      
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	0x00, 0x00, 0x00, //                      

	// @2580 'L' (20 pixels wide)
	0x00, 0x00, 0x00, //                      
	0x00, 0x00, 0x00, //                      
	0x00, 0x00, 0x00, //                      
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	0x00, 0x00, 0x00, //                      

	// @2640 'M' (20 pixels wide)
	0x00, 0x00, 0x00, //                      
	0x00, 0x00, 0x00, //                      
	0x3F, 0xFF, 0x80, //   ###############    
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	0x00, 0x00, 0x00, //                      

	// @2700 'N' (20 pixels wide)
	0x00, 0x00, 0x00, //                      
	0x00, 0x00, 0x00, //                      
	0x00, 0x00, 0x00, //                      
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	0x00, 0x00, 0x00, //                      

	// @2760 'O' (20 pixels wide)
	0x00, 0x00, 0x00, //                      
	0x00, 0x00, 0x00, //                      
	0x03, 0xF8, 0x00, //       #######        
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	0x00, 0x00, 0x00, //                      

	// @2820 'P' (20 pixels wide)
	0x00, 0x00, 0x00, //                      
	0x00, 0x00, 0x00, //                      
	0x00, 0x00, 0x00, //                      
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	0x00, 0x00, 0x00, //                      

	// @2880 'Q' (20 pixels wide)
	0x00, 0x00, 0x00, //                      
	0x00, 0x00, 0x00, //                      
	0x03, 0xF8, 0x00, //       #######        
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	0x00, 0x00, 0x00, //                      

	// @2940 'R' (20 pixels wide)
	0x00, 0x00, 0x00, //                      
	0x00, 0x00, 0x00, //                      
	0x00, 0x00, 0x00, //                      
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	0x00, 0x00, 0x00, //                      

	// @3000 'S' (20 pixels wide)
	0x00, 0x00, 0x00, //                      
	0x00, 0x00, 0x00, //                      
	0x00, 0x00, 0x00, //                      
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	0x00, 0x00, 0x00, //                      

	// @3060 'T' (20 pixels wide)
	0x00, 0x00, 0x00, //                      
	0x00, 0x00, 0x00, //                      
	0x00, 0x00, 0x00, //                      
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	0x00, 0x00, 0x00, //                      

	// @3120 'U' (20 pixels wide)
	0x00, 0x00, 0x00, //                      
	0x00, 0x00, 0x00, //                      
	0x00, 0x00, 0x00, //                      
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	0x00, 0x00, 0x00, //                      

	// @3180 'V' (20 pixels wide)
	0x00, 0x00, 0x00, //                      
	0x00, 0x00, 0x00, //                      
	0x00, 0x00, 0x00, //                      
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	0x00, 0x00, 0x00, //                      

	// @3240 'W' (20 pixels wide)
	0x30, 0x00, 0x00, //   ##                 
	0x3F, 0x00, 0x00, //   ######             
	0x3F, 0xE0, 0x00, //   #########          
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	0x30, 0x00, 0x00, //   ##                 

	// @3300 'X' (20 pixels wide)
	0x00, 0x00, 0x00, //                      
	0x00, 0x00, 0x00, //                      
	0x00, 0x00, 0x00, //                      
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	0x00, 0x00, 0x00, //                      

	// @3360 'Y' (20 pixels wide)
	0x00, 0x00, 0x00, //                      
	0x00, 0x00, 0x00, //                      
	0x00, 0x00, 0x00, //                      
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	0x00, 0x00, 0x00, //                      

	// @3420 'Z' (20 pixels wide)
	0x00, 0x00, 0x00, //                      
	0x00, 0x00, 0x00, //                      
	0x00, 0x00, 0x00, //                      
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	0x00, 0x00, 0x00, //                      

	// @3480 '[' (20 pixels wide)
	0x00, 0x00, 0x00, //                      
	0x00, 0x00, 0x00, //                      
	0x00, 0x00, 0x00, //                      
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	0x00, 0x00, 0x00, //                      

	// @3540 '\' (20 pixels wide)
	0x00, 0x00, 0x00, //                      
	0x00, 0x00, 0x00, //                      
	0x00, 0x00, 0x00, //                      
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	0x00, 0x00, 0x00, //                      

	// @3600 ']' (20 pixels wide)
	0x00, 0x00, 0x00, //                      
	0x00, 0x00, 0x00, //                      
	0x00, 0x00, 0x00, //                      
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	0x00, 0x00, 0x00, //                      

	// @3660 '^' (20 pixels wide)
	0x00, 0x00, 0x00, //                      
	0x00, 0x00, 0x00, //                      
	0x00, 0x00, 0x00, //                      
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	0x00, 0x00, 0x00, //                      

	// @3720 '_' (20 pixels wide)
	0x00, 0x00, 0x00, //                      
	0x00, 0x00, 0x00, //                      
	0x00, 0x00, 0x00, //                      
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	0x00, 0x00, 0x00, //                      

	// @3780 '`' (20 pixels wide)
	0x00, 0x00, 0x00, //                      
	0x00, 0x00, 0x00, //                      
	0x00, 0x00, 0x00, //                      
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	0x00, 0x00, 0x00, //                      

	// @3840 'a' (20 pixels wide)
	0x00, 0x00, 0x00, //                      
	0x00, 0x00, 0x00, //                      
	0x00, 0x00, 0x00, //                      
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	0x00, 0x00, 0x00, //                      

	// @3900 'b' (20 pixels wide)
	0x00, 0x00, 0x00, //                      
	0x00, 0x00, 0x00, //                      
	0x00, 0x00, 0x00, //                      
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	0x00, 0x00, 0x00, //                      

	// @3960 'c' (20 pixels wide)
	0x00, 0x00, 0x00, //                      
	0x00, 0x00, 0x00, //                      
	0x00, 0x00, 0x00, //                      
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	0x00, 0x00, 0x00, //                      

	// @4020 'd' (20 pixels wide)
	0x00, 0x00, 0x00, //                      
	0x00, 0x00, 0x00, //                      
	0x00, 0x00, 0x00, //                      
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	0x00, 0x00, 0x00, //                      

	// @4080 'e' (20 pixels wide)
	0x00, 0x00, 0x00, //                      
	0x00, 0x00, 0x00, //                      
	0x00, 0x00, 0x00, //                      
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	0x00, 0x00, 0x00, //                      

	// @4140 'f' (20 pixels wide)
	0x00, 0x00, 0x00, //                      
	0x00, 0x00, 0x00, //                      
	0x00, 0x00, 0x00, //                      
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	0x00, 0x00, 0x00, //                      

	// @4200 'g' (20 pixels wide)
	0x00, 0x00, 0x00, //                      
	0x00, 0x00, 0x00, //                      
	0x00, 0x00, 0x00, //                      
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	0x00, 0x00, 0x00, //                      

	// @4260 'h' (20 pixels wide)
	0x00, 0x00, 0x00, //                      
	0x00, 0x00, 0x00, //                      
	0x00, 0x00, 0x00, //                      
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	0x00, 0x00, 0x00, //                      

	// @4320 'i' (20 pixels wide)
	0x00, 0x00, 0x00, //                      
	0x00, 0x00, 0x00, //                      
	0x00, 0x00, 0x00, //                      
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	0x00, 0x00, 0x00, //                      

	// @4380 'j' (20 pixels wide)
	0x00, 0x00, 0x00, //                      
	0x00, 0x00, 0x00, //                      
	0x00, 0x00, 0x00, //                      
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	0x00, 0x00, 0x00, //                      

	// @4440 'k' (20 pixels wide)
	0x00, 0x00, 0x00, //                      
	0x00, 0x00, 0x00, //                      
	0x00, 0x00, 0x00, //                      
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	0x00, 0x00, 0x00, //                      

	// @4500 'l' (20 pixels wide)
	0x00, 0x00, 0x00, //                      
	0x00, 0x00, 0x00, //                      
	0x00, 0x00, 0x00, //                      
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	0x00, 0x00, 0x00, //                      

	// @4560 'm' (20 pixels wide)
	0x00, 0x00, 0x00, //                      
	0x00, 0x00, 0x00, //                      
	0x03, 0xFF, 0x80, //       ###########    
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	0x00, 0x00, 0x00, //                      

	// @4620 'n' (20 pixels wide)
	0x00, 0x00, 0x00, //                      
	0x00, 0x00, 0x00, //                      
	0x00, 0x00, 0x00, //                      
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	0x00, 0x00, 0x00, //                      

	// @4680 'o' (20 pixels wide)
	0x00, 0x00, 0x00, //                      
	0x00, 0x00, 0x00, //                      
	0x00, 0x00, 0x00, //                      
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	0x00, 0x00, 0x00, //                      

	// @4740 'p' (20 pixels wide)
	0x00, 0x00, 0x00, //                      
	0x00, 0x00, 0x00, //                      
	0x00, 0x00, 0x00, //                      
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	0x00, 0x00, 0x00, //                      

	// @4800 'q' (20 pixels wide)
	0x00, 0x00, 0x00, //                      
	0x00, 0x00, 0x00, //                      
	0x00, 0x00, 0x00, //                      
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	0x00, 0x00, 0x00, //                      

	// @4860 'r' (20 pixels wide)
	0x00, 0x00, 0x00, //                      
	0x00, 0x00, 0x00, //                      
	0x00, 0x00, 0x00, //                      
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	0x00, 0x00, 0x00, //                      

	// @4920 's' (20 pixels wide)
	0x00, 0x00, 0x00, //                      
	0x00, 0x00, 0x00, //                      
	0x00, 0x00, 0x00, //                      
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	0x00, 0x00, 0x00, //                      

	// @4980 't' (20 pixels wide)
	0x00, 0x00, 0x00, //                      
	0x00, 0x00, 0x00, //                      
	0x00, 0x00, 0x00, //                      
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	0x00, 0x00, 0x00, //                      

	// @5040 'u' (20 pixels wide)
	0x00, 0x00, 0x00, //                      
	0x00, 0x00, 0x00, //                      
	0x00, 0x00, 0x00, //                      
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	0x00, 0x00, 0x00, //                      

	// @5100 'v' (20 pixels wide)
	0x00, 0x00, 0x00, //                      
	0x00, 0x00, 0x00, //                      
	0x00, 0x00, 0x00, //                      
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	0x00, 0x00, 0x00, //                      

	// @5160 'w' (20 pixels wide)
	0x00, 0x00, 0x00, //                      
	0x00, 0x00, 0x00, //                      
	0x03, 0x00, 0x00, //       ##             
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	0x00, 0x00, 0x00, //                      

	// @5220 'x' (20 pixels wide)
	0x00, 0x00, 0x00, //                      
	0x00, 0x00, 0x00, //                      
	0x00, 0x00, 0x00, //                      
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	0x00, 0x00, 0x00, //                      

	// @5280 'y' (20 pixels wide)
	0x00, 0x00, 0x00, //                      
	0x00, 0x00, 0x00, //                      
	0x00, 0x00, 0x00, //                      
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	0x00, 0x00, 0x00, //                      

	// @5340 'z' (20 pixels wide)
	0x00, 0x00, 0x00, //                      
	0x00, 0x00, 0x00, //                      
	0x00, 0x00, 0x00, //                      
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	0x00, 0x00, 0x00, //                      

	// @5400 '{' (20 pixels wide)
	0x00, 0x00, 0x00, //                      
	0x00, 0x00, 0x00, //                      
	0x00, 0x00, 0x00, //                      
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	0x00, 0x00, 0x00, //                      

	// @5460 '|' (20 pixels wide)
	0x00, 0x00, 0x00, //                      
	0x00, 0x00, 0x00, //                      
	0x00, 0x00, 0x00, //                      
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	0x00, 0x00, 0x00, //                      

	// @5520 ' ' (20 pixels wide)
	0x00, 0x00, 0x00, //                      
	0x00, 0x00, 0x00, //                      
	0x00, 0x00, 0x00, //                      
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	0x00, 0x00, 0x00, //                      

	// @5580 '~' (20 pixels wide)
	0x00, 0x00, 0x00, //                      
	0x00, 0x00, 0x00, //                      
	0x00, 0x00, 0x00, //                      
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	0x00, 0x00, 0x00, //                      

	// @5640 'µ' (20 pixels wide)
	0x00, 0x00, 0x00, //                      
	0x00, 0x00, 0x00, //                      
	0x00, 0x00, 0x00, //                      
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	0x00, 0x00, 0x00, //                      

	// @5700 '?' (20 pixels wide)
	0x00, 0x00, 0x00, //                      
	0x00, 0x00, 0x00, //                      
	0x00, 0x00, 0x00, //                      
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	0x00, 0x00, 0x00, //                      

	// @5760 'O' (20 pixels wide)
	0x00, 0x00, 0x00, //                      
	0x00, 0x00, 0x00, //                      
	0x00, 0x03, 0x80, //               ###    
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	0x00, 0x00, 0x00, //                      

	// @6402 '?' (was 22 pixels wide)
	0x00, 0x10, 0x00, //            #         
	0x00, 0x30, 0x00, //           ##         
	0x00, 0x70, 0x00, //          ###         
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	0x00, 0x10, 0x00, //            #         

	// @6468 '?' (was22 pixels wide)
	0x08, 0x00, 0x00, //     #                
	0x0C, 0x00, 0x00, //     ##               
	0x0E, 0x00, 0x00, //     ###              
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	0x00, 0x00, 0x00, //                              
	
};
